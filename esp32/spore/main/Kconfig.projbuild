## esp32/spore/main/Kconfig.projbuild
```kconfig
menu "Mooshroom"
  menu "Wifi configuration"
    config WIFI_SSID
      string "SSID name"
      default ""
      help
        The name of the network to connect to
    config WIFI_PASSWORD
      string "Password for WiFi"
      default ""
      help
        The password to use when connecting to wifi
  endmenu

  menu "MQTT configuration"
    config MQTT_URL
      string "MQTT URL"
      default ""
      help
        The name of the network to connect to
    config MQTT_USERNAME
      string "Username for MQTT auth"
      default ""
      help
        The username to use for connecting to MQTT
    config MQTT_PASSWORD
      string "Password for MQTT auth"
      default ""
      help
        The username to use for connecting to MQTT
  endmenu
  menu "Spore"
    config SPORE_NAME
      string "Device Name"
      default ""
      help
        The device name to use for Mooshroom
    config SPORE_MQTT_PREFIX
      string "MQTT Topic Prefix"
      default "mooshroom"
      help
        The MQTT prefix to use
    config DHT_PIN
      int "DHT GPIO pin"
      help
        The GPIO pin used for the DHT sensor
    config DHT_PUBLISH_INTERVAL_SECONDS
      int "DHT Publish Interval Seconds"
      default 15
      help
        The delay between publishing DHT statistics.
  endmenu
endmenu
```
